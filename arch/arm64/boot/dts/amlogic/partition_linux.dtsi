// SPDX-License-Identifier: (GPL-2.0+ OR MIT)
/*
 * Amlogic partition set for normal
 *
 * Copyright (c) 2017-2017 Amlogic Ltd
 *
 * This file is licensed under a dual GPLv2 or BSD license.
 *
 */

/ {
	partitions: partitions{
		parts = <1>;
		part-0 = <&rootfs>;

		rootfs:rootfs
		{
			pname = "rootfs";
			size = <0xffffffff 0xffffffff>;
			mask = <4>;
		};
	};
};/* end of / */
